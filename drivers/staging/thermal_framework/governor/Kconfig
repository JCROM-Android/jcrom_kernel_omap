## drivers/staging/thermal_framework/governor/Kconfig
```kconfig
#
# Thermal governor driver config
#

config OMAP_DIE_GOVERNOR
	bool "OMAP On Die thermal governor support"
	depends on THERMAL_FRAMEWORK && OMAP_THERMAL
	help
	  Enabling this config will give support for the on-die
	  temp sensor for the OMAP platform.  This is the governor which
	  will institute the policy to call specific cooling devices
```

## drivers/staging/thermal_framework/sensor/Kconfig
```kconfig
#
# Thermal Temp sensor configuration
#

config OMAP_DIE_TEMP_SENSOR
	bool "OMAP On-Die temp sensor support"
	depends on THERMAL_FRAMEWORK && OMAP_THERMAL && OMAP_TEMP_SENSOR
	help
	  Enabling this config will give support for the on-die
	  temp sensor for the OMAP platform.
```

## security/smc/Kconfig
```kconfig
config TF_MSHIELD
	bool

config SECURITY_MIDDLEWARE_COMPONENT
	bool "Enable SMC Driver"
	depends on ARCH_OMAP3 || ARCH_OMAP4
	default n
	select TF_MSHIELD
	help
	  This option adds kernel support for communication with the SMC
	  Protected Application.

	  If you are unsure how to answer this question, answer N.

config SMC_KERNEL_CRYPTO
	bool "Register SMC into kernel crypto subsytem"
	depends on SECURITY_MIDDLEWARE_COMPONENT
	default y
	help
	  This option enables crypto subsystem to use SMC and OMAP hardware
	  accelerators.

	  If you are unsure how to answer this question, answer Y.

config SMC_KERNEL_CRYPTO_STANDALONE
	bool "Make SMC work without the Protected App"
	depends on SMC_KERNEL_CRYPTO
	default y
	help
	  The crypto driver can work with a running Protected App, and to do so
          it needs to communicate with the Protected App to share the hardware
          encryption engines.  If you are not using a Protected App, say yes here
          so the kernel does not try to communicate with a non-existent app.

	  If you are unsure how to answer this question, answer Y.

config SECURE_TRACE
	bool "Enable SMC secure traces"
	depends on SECURITY_MIDDLEWARE_COMPONENT && ARCH_OMAP4
	default y
	help
	  This option enables traces from the SMC Protected Application to be
	  displayed in kernel logs.

config TF_DRIVER_DEBUG_SUPPORT
	bool "Debug support"
	depends on SECURITY_MIDDLEWARE_COMPONENT
	default n
	help
	  This options enables debug traces in the driver.

config SMC_BENCH_SECURE_CYCLE
	bool "Enable secure cycles benchmarks"
	depends on TF_DRIVER_DEBUG_SUPPORT && ARCH_OMAP4
	default n
	help
	  This options enables benchmarks.
```
